## esp32/sdkconfig.defaults
```kconfig
#
# Serial Flasher Config
#
CONFIG_ESPTOOLPY_FLASHSIZE_4MB=y
# end of Serial Flasher Config

#
# Partition Table
#
CONFIG_PARTITION_TABLE_CUSTOM=y
CONFIG_PARTITION_TABLE_CUSTOM_FILENAME="partitions.csv"
# end of Partition Table

#
# Bluetooth / NimBLE
#
CONFIG_BT_ENABLED=y
CONFIG_BT_NIMBLE_ENABLED=y
# end of Bluetooth / NimBLE

#
# FREERTOS
#
CONFIG_FREERTOS_HZ=1000
# end of FREERTOS
# end of Component config
```
